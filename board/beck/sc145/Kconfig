## board/beck/sc145/Kconfig
```kconfig
if TARGET_BECK_SC145

config SYS_BOARD
	default "sc145"

config SYS_VENDOR
	default "beck"

config SYS_SOC
	default "mx6"

config SYS_CONFIG_NAME
	default "beck_sc145"

endif
```

## board/beck/sc165/Kconfig
```kconfig
if TARGET_BECK_SC165

config SYS_BOARD
	default "sc165"

config SYS_VENDOR
	default "beck"

config SYS_SOC
	default "mx6"

config SYS_CONFIG_NAME
	default "beck_sc165"

endif
```

## configs/beck_sc145_defconfig
```kconfig
CONFIG_SYS_EXTRA_OPTIONS="IMX_CONFIG=board/beck/sc145/imximage.cfg,MX6UL,SYS_BOOT_QSPI"
CONFIG_ARM=y
CONFIG_TARGET_BECK_SC145=y
CONFIG_DM=y
CONFIG_DM_THERMAL=y
```

## configs/beck_sc145_sd_defconfig
```kconfig
CONFIG_SYS_EXTRA_OPTIONS="IMX_CONFIG=board/beck/sc145/imximage.cfg,MX6UL"
CONFIG_ARM=y
CONFIG_TARGET_BECK_SC145=y
CONFIG_DM=y
CONFIG_DM_THERMAL=y
```

## configs/beck_sc165_sd_defconfig
```kconfig
CONFIG_SYS_EXTRA_OPTIONS="IMX_CONFIG=board/beck/sc165/imximage.cfg,MX6UL"
CONFIG_ARM=y
CONFIG_TARGET_BECK_SC165=y
CONFIG_DM=y
CONFIG_DM_THERMAL=y
```
